## config/west.yml
```yaml
manifest:
  remotes:
    - name: zmkfirmware
      url-base: https://github.com/zmkfirmware
  projects:
    - name: zmk
      remote: zmkfirmware
      revision: c23443a086b62833ba0b88dd3a271993d3bc9cea
      import: app/west.yml
  self:
    path: config
```
